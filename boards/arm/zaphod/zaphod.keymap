/*
*
* Copyright (c) 2022-23 Alan Reiser
* SPDX-License-Identifier: MIT
*
*/

#include <behaviors.dtsi>
#include <dt-bindings/zmk/keys.h>
#include <dt-bindings/zmk/bt.h>

#include "zaphod_config.h" // key name defs for this board
#include "moutis_config.h" // my add-on feature defs

/ {
#include "moutis_behaviors.dtsi"
#include "moutis_macros.dtsi"
#include "moutis_combos-vx.dtsi"

    keymap {
        compatible = "zmk,keymap";
#include "zaphod.l_alpha-HD-vx.dtsi"  // base (alpha) layer (& related adaptive layers)
#include "zaphod.l_layers.dtsi"  // all other (common) layers (shouldn't vary)

    };
};
