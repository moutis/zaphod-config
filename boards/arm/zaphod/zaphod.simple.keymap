/*
*
* Copyright (c) 2022 Alan Reiser
* SPDX-License-Identifier: MIT
*
*/

#include <behaviors.dtsi>
#include <dt-bindings/zmk/keys.h>
#include <dt-bindings/zmk/bt.h>

#include "moutis_config.h"

/ {
#include "moutis_behaviors.dtsi"
#include "moutis_macros.dtsi"

    keymap {
        compatible = "zmk,keymap";
#include "zaphod.l_alpha-HD-vb.dtsi"  // base (alpha) layer (& related to adaptives)
#include "zaphod.l_layers.dtsi"  // all other (common) layers (shouldn't vary)

    };
};
