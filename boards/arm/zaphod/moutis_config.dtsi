//
//  moutis_config.dtsi
//  
//
//  Created by Alan on 7/24/22.
//

#define ___  &trans


#define l_any   -1
#define l_alpha  0
#define l_nav    1
#define l_sym    2
#define l_fn     3
#define l_num    4
#define l_cfg    5
#define a_l      6 // adaptive layer for M->L

&ak { // Adaptive key uses another layer
    release-after-ms = <170>;
};

&mt {
    tapping-term-ms = <170>;
};

#define EN_PRONOUN_COMBOS //  (I, I'm, I've I'd I'll etc)
