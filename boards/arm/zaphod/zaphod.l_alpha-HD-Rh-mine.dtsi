/*    KEY POSITIONS for Zaphod
╭────────────────╮ ╭────────────────╮
│  0  1  2  3  4 │ │  5  6  7  8  9 │
│ 10 11 12 13 14 │ │ 15 16 17 18 19 |
| 20 21 22 23 24 │ │ 25 26 27 28 29 |
╰────────╮ 30 31 | | 32 33 ╭────────╯
         ╰───────╯ ╰───────╯   */

/*  Base (alpha) Layer  (Hands Down Rh)
Building for a 36 key board
╭────────────────────╮ ╭────────────────────╮
│  W   G   M   P  J  │ │ #$  .:  /*  "[  '] │
│  C   S   N   T  K  | | ,;   A   E   I   H │
│  X   F   L   D  V  │ │ -+   U   O   Y   B │
╰───────╮ SPC BSP R  │ │ SPC RET ENT ╭──────╯
        ╰────────────╯ ╰─────────────╯   */

                default_layer {
                        label = "HD-rh";
                        bindings = <

//   &none &none &none &none &none &none   &none &none &none &none &none &none
//   &none &none &none &none &none &none   &none &none &none &none &none &none
//   &none &none &none &none &none &none   &none &none &none &none &none &none
//                     &none &none &none   &none &none &none

&kp W       &kp G &kp M     &kp P       &kp J                   &HashDllr  &DotColn    &SlshStar   &DqtLbkt    &SqtRbkt
&hrm LCTRL C &hrm LALT S  &hrm LGUI N  &hrm LSHFT T &lt l_num K &CmmaSemi  &hrm RSHFT A &hrm RGUI E  &hrm RALT I  &hrm RCTRL H
&kp X       &kp F &kp L     &kp D       &kp V                   &MinusPlus  &kp U      &kp O       &kp Y       &kp B


                &lt l_fn BACKSPACE &lt l_nav R      &lt l_sym SPACE &lt l_nav RETURN
                        >;
                };

