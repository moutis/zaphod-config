/*
*
* Copyright (c) 2022 Alan Reiser
* SPDX-License-Identifier: MIT
*
*/

#include <behaviors.dtsi>
#include <dt-bindings/zmk/keys.h>
#include <dt-bindings/zmk/bt.h>

#include "moutis_config.dtsi"

/ {
#include "moutis_behaviors.dtsi"
#include "moutis_macros.dtsi"
#include "moutis_combos.dtsi"

    keymap {
        compatible = "zmk,keymap";
#include "zaphod.l_alpha-HD-Rh-mine.dtsi"  // base (alpha) layer
#include "zaphod.l_layers.dtsi"  // all other (common) layers

    };
};
